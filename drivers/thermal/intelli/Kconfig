## drivers/thermal/intelli/Kconfig
```kconfig
choice
	prompt "MSM Thermal Monitor Types"
	default THERMAL_MONITOR

config INTELLI_THERMAL_V2
	bool "Better thermal monitor for MSM V2"
	depends on THERMAL_TSENS8974
	depends on CPU_FREQ_MSM
	help
	  This enables thermal monitoring capability in the kernel replacing
	  userspace thermal monitoring altogether.

config THERMAL_MONITOR
	bool "Monitor thermal state and limit CPU Frequency"
	depends on THERMAL_TSENS8960 || THERMAL_TSENS8974
	depends on CPU_FREQ_MSM
	help
	  This enables thermal monitoring capability in the kernel in the
	  absence of a system wide thermal monitoring entity or until such an
	  entity starts running in the userspace. Monitors TSENS temperature
	  and limits the max frequency of the cores.

endchoice
```
